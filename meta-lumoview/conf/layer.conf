## meta-lumoview/conf/layer.conf
```bitbake
# We have a conf and classes directory, append to BBPATH
BBPATH .= ":${LAYERDIR}"

# We have recipes-* directories, add to BBFILES
BBFILES += "${LAYERDIR}/recipes-*/*/*.bb \
	        ${LAYERDIR}/recipes-*/*/*.bbappend \
	        ${LAYERDIR}/recipes-*/*.bb \
            ${LAYERDIR}/recipes-*/*.bbappend \ 
            ${LAYERDIR}/recipes-*/*/*/*.bb \
            ${LAYERDIR}/recipes-*/*/*/*.bbappend \
	   "
BBFILE_COLLECTIONS += "lumoview-layer"
BBFILE_PATTERN_lumoview-layer := "^${LAYERDIR}/"
BBFILE_PRIORITY_lumoview-layer = "10"

LAYERSERIES_COMPAT_lumoview-layer = "kirkstone scarthgap"
LAYERDEPENDS_lumoview-layer = " \
    core \
    openembedded-layer \
    virtualization-layer \
"
```

## meta-lumoview/conf/machine/myqemux86-64.conf
```bitbake
require conf/machine/qemux86-64.conf

# To mime UEFI
MACHINE_FEATURES:append = " pcbios efi"
EXTRA_IMAGEDEPENDS += "ovmf"

# Set Memory to 8 GB
QB_MEM = " -m 8192 "

# Enable KVM, gtk+ and ovmf
QB_OPT_APPEND += " -enable-kvm -display gtk -drive if=pflash,format=qcow2,file=${DEPLOY_DIR}/images/${MACHINE}/ovmf.qcow2"


MACHINEOVERRIDES =. "qemux86-64:"
KMACHINE:myqemux86-64 = "qemux86-64"

# Setting stuff for simulating rauc setup

IMAGE_FSTYPES = " \
    tar.bz2 \
    wic \
"
#WKS_FILE = "partition-grub-a-b-data-overlay.wks"
#WKS_FILE_DEPENDS = "boot-image"
#PREFERRED_RPROVIDER_virtual-grub-bootconf = "rauc-alt-grubconf"
```
